## boards/shields/skeletyl/Kconfig.defconfig
```kconfig
if SHIELD_SKELETYL_LEFT

config ZMK_KEYBOARD_NAME
	default "Skeletyl"

config ZMK_SPLIT_BLE_ROLE_CENTRAL
	default y

endif

if SHIELD_SKELETYL_RIGHT

config ZMK_KEYBOARD_NAME
	default "Skeletyl Right"

endif

if SHIELD_SKELETYL_LEFT || SHIELD_SKELETYL_RIGHT

config ZMK_SPLIT
	default y

endif

# --- Dongle setup ---

if SHIELD_SKELETYL_CENTRAL_DONGLE

config ZMK_KEYBOARD_NAME
	default "Skeletyl"

config ZMK_SPLIT_ROLE_CENTRAL
	default y

endif

if SHIELD_SKELETYL_CENTRAL_DONGLE || SHIELD_SKELETYL_PERIPHERAL_LEFT || SHIELD_SKELETYL_PERIPHERAL_RIGHT

config ZMK_SPLIT
	default y

if ZMK_DISPLAY

config I2C
	default y

config SSD1306
	default y

choice ZMK_DISPLAY_WORK_QUEUE
	default ZMK_DISPLAY_WORK_QUEUE_DEDICATED
endchoice

endif

if SSD1306

config LV_Z_VDB_SIZE
	default 64

config LV_DPI_DEF
	default 148

config LV_Z_BITS_PER_PIXEL
	default 1

choice LV_COLOR_DEPTH
	default LV_COLOR_DEPTH_1
endchoice

endif

endif
```

## boards/shields/skeletyl/Kconfig.shield
```kconfig
config SHIELD_SKELETYL_LEFT
    def_bool $(shields_list_contains,skeletyl_left)

config SHIELD_SKELETYL_RIGHT
    def_bool $(shields_list_contains,skeletyl_right)

config SHIELD_SKELETYL_CENTRAL_DONGLE
    def_bool $(shields_list_contains,skeletyl_central_dongle)

config SHIELD_SKELETYL_PERIPHERAL_LEFT
    def_bool $(shields_list_contains,skeletyl_peripheral_left)

config SHIELD_SKELETYL_PERIPHERAL_RIGHT
    def_bool $(shields_list_contains,skeletyl_peripheral_right)
```
